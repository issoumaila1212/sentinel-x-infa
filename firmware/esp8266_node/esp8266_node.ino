// Sentinel X - ESP8266 node
// Reads the gas sensor and publishes it to the MQTT broker over TLS.
#include <ESP8266WiFi.h>
#include <WiFiClientSecure.h>
#include <PubSubClient.h>
#include <time.h>
#include "secrets.h"   // Wi-Fi + MQTT credentials (not committed to Git)
#include "ca_cert.h"   // CA certificate, generated by gen_certs.sh

// ---------- Settings ----------
const char* DEVICE_ID     = "node1";
const char* TOPIC_SENSORS = "aether/node1/sensors";
const char* TOPIC_CMD     = "aether/node1/cmd";

// false = encrypted, but the server is NOT verified (use for the first tests)
// true  = the server certificate is verified against our CA (needs NTP time)
const bool USE_CA_VALIDATION = false;

const uint8_t GAS_PIN = A0;
const unsigned long PUBLISH_EVERY_MS = 2000;
const unsigned long MAX_OFFLINE_MS   = 120000;  // reboot if no link for 2 minutes
// ------------------------------

BearSSL::WiFiClientSecure net;
BearSSL::X509List caList(CA_CERT);
PubSubClient mqtt(net);

unsigned long lastSend = 0;
unsigned long lastOk = 0;

void onMessage(char* topic, byte* payload, unsigned int len) {
  Serial.print("Received on ");
  Serial.print(topic);
  Serial.print(": ");
  for (unsigned int i = 0; i < len; i++) Serial.print((char)payload[i]);
  Serial.println();
}

// Average of 10 readings to reduce noise. Returns 0..1023.
int readGas() {
  long sum = 0;
  for (int i = 0; i < 10; i++) {
    sum += analogRead(GAS_PIN);
    delay(5);
  }
  return (int)(sum / 10);
}

void connectWifi() {
  Serial.print("Connecting to Wi-Fi");
  WiFi.mode(WIFI_STA);
  WiFi.begin(WIFI_SSID, WIFI_PASS);
  unsigned long start = millis();
  while (WiFi.status() != WL_CONNECTED && millis() - start < 20000) {
    delay(500);
    Serial.print(".");
  }
  if (WiFi.status() == WL_CONNECTED) {
    Serial.print(" connected, ESP IP: ");
    Serial.println(WiFi.localIP());
  } else {
    Serial.println(" failed, will retry");
    WiFi.disconnect();
  }
}

void syncTime() {
  // Certificate validation needs the current date
  configTime(0, 0, "pool.ntp.org", "time.nist.gov");
  Serial.print("Syncing time");
  unsigned long start = millis();
  time_t now = time(nullptr);
  while (now < 1700000000 && millis() - start < 30000) {
    delay(500);
    Serial.print(".");
    now = time(nullptr);
  }
  Serial.println(now >= 1700000000 ? " ok" : " FAILED");
}

void connectMqtt() {
  Serial.print("MQTT (TLS) connecting... ");
  String id = "aether-node1-" + String(ESP.getChipId(), HEX);
  if (mqtt.connect(id.c_str(), MQTT_USER, MQTT_PASS)) {
    Serial.println("ok");
    mqtt.subscribe(TOPIC_CMD);
  } else {
    char err[128];
    net.getLastSSLError(err, sizeof(err));
    Serial.print("failed, rc=");
    Serial.print(mqtt.state());
    Serial.print(", ssl: ");
    Serial.println(err);
    delay(3000);
  }
}

void setup() {
  Serial.begin(115200);
  delay(200);
  Serial.println();

  while (WiFi.status() != WL_CONNECTED) connectWifi();

  if (USE_CA_VALIDATION) {
    syncTime();
    net.setTrustAnchors(&caList);
    Serial.println("Mode: TLS + CA validation");
  } else {
    net.setInsecure();
    Serial.println("Mode: TLS, server NOT verified");
  }
  net.setBufferSizes(512, 512);  // saves RAM on the ESP8266

  mqtt.setServer(MQTT_HOST, MQTT_PORT);
  mqtt.setCallback(onMessage);
  lastOk = millis();
}

void loop() {
  if (WiFi.status() != WL_CONNECTED) connectWifi();
  if (WiFi.status() == WL_CONNECTED && !mqtt.connected()) connectMqtt();

  if (mqtt.connected()) {
    lastOk = millis();
    mqtt.loop();

    if (millis() - lastSend >= PUBLISH_EVERY_MS) {
      lastSend = millis();
      int gas = readGas();
      char payload[64];
      snprintf(payload, sizeof(payload), "{\"device\":\"%s\",\"gas\":%d}", DEVICE_ID, gas);
      bool ok = mqtt.publish(TOPIC_SENSORS, payload);
      Serial.print(payload);
      Serial.println(ok ? "  -> sent" : "  -> FAILED");
    }
  } else if (millis() - lastOk > MAX_OFFLINE_MS) {
    Serial.println("Offline too long, restarting...");
    ESP.restart();
  }
}
